## examples/linux/buildroot/riscv64_qemu_virt_defconfig
```kconfig
BR2_riscv=y
BR2_RISCV_64=y
BR2_TOOLCHAIN_BUILDROOT_GLIBC=y
BR2_TARGET_GENERIC_HOSTNAME="harbor"
BR2_TARGET_GENERIC_ISSUE="Welcome to Harbor Buildroot"
BR2_TARGET_GENERIC_GETTY_PORT="ttyS0"
BR2_SYSTEM_DHCP="eth0"
BR2_LINUX_KERNEL=y
BR2_LINUX_KERNEL_USE_ARCH_DEFAULT_CONFIG=y
BR2_LINUX_KERNEL_IMAGE=y
BR2_TARGET_ROOTFS_CPIO=y
```
